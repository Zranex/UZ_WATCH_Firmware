## sdkconfig.defaults
```kconfig
# ============================================================================
# UZ WATCH v2 — SDK Configuration Defaults
# OLEDS3Watch Waveshare ESP32-S3-Touch-AMOLED-2.06 Official Configuration
# ============================================================================

CONFIG_IDF_TARGET="esp32s3"
CONFIG_ESPTOOLPY_FLASHMODE_QIO=y
CONFIG_ESPTOOLPY_FLASHSIZE_16MB=y
CONFIG_PARTITION_TABLE_CUSTOM=y
CONFIG_PARTITION_TABLE_CUSTOM_FILENAME="partitions.csv"

# ---- Compiler & Optimization ----
CONFIG_COMPILER_OPTIMIZATION_PERF=y

# ---- PSRAM & Octal SPIRAM ----
CONFIG_SPIRAM=y
CONFIG_SPIRAM_MODE_OCT=y
CONFIG_SPIRAM_FETCH_INSTRUCTIONS=y
CONFIG_SPIRAM_RODATA=y
CONFIG_SPIRAM_SPEED_80M=y
CONFIG_SPIRAM_MALLOC_ALWAYSINTERNAL=4096
CONFIG_SPIRAM_MALLOC_RESERVE_INTERNAL=4096
# ---- Wi-Fi / LwIP Core Pinning ----
CONFIG_LWIP_TCPIP_TASK_AFFINITY_CPU0=y

# ---- CPU & FreeRTOS ----
CONFIG_ESP_DEFAULT_CPU_FREQ_MHZ_240=y
CONFIG_FREERTOS_HZ=1000

# ---- Console Output (USB Serial JTAG) ----
CONFIG_ESP_CONSOLE_USB_SERIAL_JTAG=y

# ---- ESP-Brookesia Settings ----
CONFIG_ESP_BROOKESIA_MEMORY_USE_CUSTOM=y

# ---- BSP & Display Settings (AMOLED CO5300) ----
CONFIG_BSP_LCD_RGB_BOUNCE_BUFFER_HEIGHT=50
CONFIG_BSP_LCD_RGB_BUFFER_NUMS=2
CONFIG_BSP_DISPLAY_LVGL_TASK_STACK_SIZE_KB=6
CONFIG_BSP_DISPLAY_LVGL_BUF_HEIGHT=50
CONFIG_LV_COLOR_SCREEN_TRANSP=y
CONFIG_LV_MEMCPY_MEMSET_STD=y
CONFIG_LV_USE_PERF_MONITOR=n


# ---- LVGL 16-Bit Color Endianness Swap (CRITICAL FOR CO5300 AMOLED!) ----
CONFIG_LV_COLOR_16_SWAP=y
CONFIG_LV_COLOR_DEPTH_16=y

# ---- LVGL Fonts ----
CONFIG_LV_FONT_MONTSERRAT_8=y
CONFIG_LV_FONT_MONTSERRAT_10=y
CONFIG_LV_FONT_MONTSERRAT_12=y
CONFIG_LV_FONT_MONTSERRAT_14=y
CONFIG_LV_FONT_MONTSERRAT_16=y
CONFIG_LV_FONT_MONTSERRAT_18=y
CONFIG_LV_FONT_MONTSERRAT_20=y
CONFIG_LV_FONT_MONTSERRAT_22=y
CONFIG_LV_FONT_MONTSERRAT_24=y
CONFIG_LV_FONT_MONTSERRAT_26=y
CONFIG_LV_FONT_MONTSERRAT_28=y
CONFIG_LV_FONT_MONTSERRAT_30=y
CONFIG_LV_FONT_MONTSERRAT_32=y
CONFIG_LV_FONT_MONTSERRAT_34=y
CONFIG_LV_FONT_MONTSERRAT_36=y
CONFIG_LV_FONT_MONTSERRAT_38=y
CONFIG_LV_FONT_MONTSERRAT_40=y
CONFIG_LV_FONT_MONTSERRAT_42=y
CONFIG_LV_FONT_MONTSERRAT_44=y
CONFIG_LV_FONT_MONTSERRAT_48=y
CONFIG_LV_FONT_FMT_TXT_LARGE=y
CONFIG_LV_USE_FONT_COMPRESSED=y
CONFIG_LV_USE_SNAPSHOT=y

CONFIG_I2C_MASTER_FREQUENCY=400000
CONFIG_PMU_INTERRUPT_PIN=35
CONFIG_ESPTOOLPY_FLASHFREQ_80M=y
CONFIG_SPIRAM_TRY_ALLOCATE_WIFI_LWIP=y

CONFIG_SPIRAM_TRY_ALLOCATE_WIFI_LWIP=y


CONFIG_BT_ENABLED=y
CONFIG_BT_NIMBLE_ENABLED=y
CONFIG_BT_NIMBLE_HOST_TASK_STACK_SIZE=5120
CONFIG_BT_NIMBLE_MEM_ALLOC_MODE_INTERNAL=y

CONFIG_ESP_CONSOLE_USB_SERIAL_JTAG=y
CONFIG_ESP_CONSOLE_USB_SERIAL_JTAG_ENABLED=y
CONFIG_USJ_ENABLE_USB_SERIAL_JTAG=y

CONFIG_BSP_DISPLAY_LVGL_AVOID_TEAR=y
CONFIG_BSP_DISPLAY_LVGL_FULL_REFRESH=y

CONFIG_FREERTOS_WATCHPOINT_END_OF_STACK=n

CONFIG_LV_BUILD_EXAMPLES=n
```
